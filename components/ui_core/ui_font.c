#include "ui_font.h"
#include "st7789.h"
#include <string.h>

// ============================================================
// 6x8 bitmap font (ASCII 32–126)
// Each char: 6 columns, 8 rows. Bit 0 of each byte = top pixel.
// ============================================================
static const uint8_t s_font6x8[][6] = {
    {0x00,0x00,0x00,0x00,0x00,0x00}, // ' '
    {0x00,0x00,0x5F,0x00,0x00,0x00}, // '!'
    {0x00,0x07,0x00,0x07,0x00,0x00}, // '"'
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    {0x0C,0x02,0x0C,0x00,0x00,0x00}, // '~'
};

#define FONT_W  6
#define FONT_H  8

int ui_char(int x, int y, char c, uint16_t color, uint8_t scale)
{
    if (c < 32 || c > 126) c = '?';
    const uint8_t *glyph = s_font6x8[c - 32];

    for (int col = 0; col < FONT_W; col++) {
        uint8_t bits = glyph[col];
        for (int row = 0; row < FONT_H; row++) {
            if (bits & (1 << row)) {
                for (int sy = 0; sy < scale; sy++) {
                    for (int sx = 0; sx < scale; sx++) {
                        st7789_fb_pixel(
                            (uint16_t)(x + col * scale + sx),
                            (uint16_t)(y + row * scale + sy),
                            color);
                    }
                }
            }
        }
    }
    return x + FONT_W * scale;
}

int ui_str(int x, int y, const char *s, uint16_t color, uint8_t scale)
{
    while (*s) {
        x = ui_char(x, y, *s++, color, scale);
    }
    return x;
}

int ui_str_width(const char *s, uint8_t scale)
{
    return strlen(s) * FONT_W * scale;
}

void ui_str_center(int y, const char *s, uint16_t color, uint8_t scale)
{
    int w = ui_str_width(s, scale);
    ui_str((LCD_W - w) / 2, y, s, color, scale);
}

void ui_str_right(int x_end, int y, const char *s, uint16_t color, uint8_t scale)
{
    int w = ui_str_width(s, scale);
    ui_str(x_end - w, y, s, color, scale);
}

void ui_large_time(int x, int y, const char *hhmm, uint16_t color)
{
    // Scale 4 = 24x32 pixels per char, suitable for clock display
    ui_str(x, y, hhmm, color, 4);
}
